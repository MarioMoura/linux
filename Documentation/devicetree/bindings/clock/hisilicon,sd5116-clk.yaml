## Documentation/devicetree/bindings/clock/hisilicon,sd5116-clk.yaml
```yaml
# SPDX-License-Identifier: (GPL-2.0-only OR BSD-2-Clause)
%YAML 1.2
---
$id: http://devicetree.org/schemas/clock/hisilicon,sd5116-clk.yaml#
$schema: http://devicetree.org/meta-schemas/core.yaml#

title: HiSilicon SD5116 clock gates

maintainers:
  - Mario Moura <mm@mariomoura.com>

description: |
  Peripheral clock gates in the HiSilicon SD5116 system controller. It must
  be a child node of the "hisilicon,sd5116-sysctrl" system controller, whose
  registers it uses.

  See include/dt-bindings/clock/hisilicon,sd5116-clock.h for the clock IDs.

properties:
  compatible:
    const: hisilicon,sd5116-clk

  clocks:
    maxItems: 1
    description: Bus clock feeding the gated peripherals

  '#clock-cells':
    const: 1

required:
  - compatible
  - clocks
  - '#clock-cells'

additionalProperties: false

examples:
  - |
    clock-controller {
        compatible = "hisilicon,sd5116-clk";
        clocks = <&apb_clk>;
        #clock-cells = <1>;
    };
```

## Documentation/devicetree/bindings/net/dsa/hisilicon,sd5116-switch.yaml
```yaml
# SPDX-License-Identifier: (GPL-2.0-only OR BSD-2-Clause)
%YAML 1.2
---
$id: http://devicetree.org/schemas/net/dsa/hisilicon,sd5116-switch.yaml#
$schema: http://devicetree.org/meta-schemas/core.yaml#

title: HiSilicon SD5116 embedded Ethernet switch

maintainers:
  - Mario Moura <mm@mariomoura.com>

description:
  The switch embedded in the HiSilicon SD5116 SoC has a PON port (0), a CPU
  port (4) connected to the Packet Interface Engine, and Gigabit Ethernet
  ports starting at 8, each with its own MAC. The switch registers are
  directly mapped in the SoC's memory.

allOf:
  - $ref: dsa.yaml#/$defs/ethernet-ports

properties:
  compatible:
    const: hisilicon,sd5116-switch

  reg:
    items:
      - description: switch core registers
      - description: Gigabit Ethernet MAC registers

  reg-names:
    items:
      - const: switch
      - const: mac

  hisilicon,sysctrl:
    $ref: /schemas/types.yaml#/definitions/phandle
    description:
      System controller holding the switch datapath reset.

required:
  - compatible
  - reg
  - reg-names
  - hisilicon,sysctrl
  - ethernet-ports

unevaluatedProperties: false

examples:
  - |
    switch@11000000 {
        compatible = "hisilicon,sd5116-switch";
        reg = <0x11000000 0x1500000>, <0x14300000 0x300000>;
        reg-names = "switch", "mac";
        hisilicon,sysctrl = <&sysctrl>;

        ethernet-ports {
            #address-cells = <1>;
            #size-cells = <0>;

            ethernet-port@4 {
                reg = <4>;
                ethernet = <&pie>;
                phy-mode = "internal";

                fixed-link {
                    speed = <1000>;
                    full-duplex;
                };
            };

            ethernet-port@8 {
                reg = <8>;
                label = "lan";
                phy-handle = <&ethphy0>;
                phy-mode = "gmii";
            };
        };
    };
```

## Documentation/devicetree/bindings/net/hisilicon,sd5116-mdio.yaml
```yaml
# SPDX-License-Identifier: (GPL-2.0-only OR BSD-2-Clause)
%YAML 1.2
---
$id: http://devicetree.org/schemas/net/hisilicon,sd5116-mdio.yaml#
$schema: http://devicetree.org/meta-schemas/core.yaml#

title: HiSilicon SD5116 MDIO controller

maintainers:
  - Mario Moura <mm@mariomoura.com>

allOf:
  - $ref: mdio.yaml#

properties:
  compatible:
    const: hisilicon,sd5116-mdio

  reg:
    maxItems: 1

required:
  - compatible
  - reg

unevaluatedProperties: false

examples:
  - |
    mdio@14600000 {
        compatible = "hisilicon,sd5116-mdio";
        reg = <0x14600000 0x20>;
        #address-cells = <1>;
        #size-cells = <0>;

        ethernet-phy@1 {
            reg = <1>;
        };
    };
```

## Documentation/devicetree/bindings/net/hisilicon,sd5116-pie.yaml
```yaml
# SPDX-License-Identifier: (GPL-2.0-only OR BSD-2-Clause)
%YAML 1.2
---
$id: http://devicetree.org/schemas/net/hisilicon,sd5116-pie.yaml#
$schema: http://devicetree.org/meta-schemas/core.yaml#

title: HiSilicon SD5116 Packet Interface Engine

maintainers:
  - Mario Moura <mm@mariomoura.com>

description:
  The Packet Interface Engine (PIE) is the DMA engine between the CPU and the
  CPU port of the SD5116 embedded switch. It is used as the conduit interface
  of that switch.

allOf:
  - $ref: ethernet-controller.yaml#

properties:
  compatible:
    const: hisilicon,sd5116-pie

  reg:
    maxItems: 1

  interrupts:
    maxItems: 1

required:
  - compatible
  - reg
  - interrupts

unevaluatedProperties: false

examples:
  - |
    #include <dt-bindings/interrupt-controller/arm-gic.h>

    ethernet@10a70000 {
        compatible = "hisilicon,sd5116-pie";
        reg = <0x10a70000 0x300>;
        interrupts = <GIC_SPI 87 IRQ_TYPE_LEVEL_HIGH>;
    };
```

## Documentation/devicetree/bindings/spi/hisilicon,sd5116-sfc.yaml
```yaml
# SPDX-License-Identifier: (GPL-2.0-only OR BSD-2-Clause)
%YAML 1.2
---
$id: http://devicetree.org/schemas/spi/hisilicon,sd5116-sfc.yaml#
$schema: http://devicetree.org/meta-schemas/core.yaml#

title: HiSilicon SD5116 SPI Flash Controller (SFC300)

maintainers:
  - Mario Moura <mm@mariomoura.com>

description:
  SPI NOR flash controller found in the HiSilicon SD5116 GPON SoC. It
  provides a command interface with a 64-byte data buffer and a
  memory-mapped read window, and supports two chip selects.

allOf:
  - $ref: /schemas/spi/spi-controller.yaml#

properties:
  compatible:
    const: hisilicon,sd5116-sfc

  reg:
    items:
      - description: Controller registers
      - description: Memory-mapped flash window

  reg-names:
    items:
      - const: control
      - const: memory

  clocks:
    maxItems: 1

required:
  - compatible
  - reg
  - reg-names

unevaluatedProperties: false

examples:
  - |
    spi@10a20000 {
        compatible = "hisilicon,sd5116-sfc";
        reg = <0x10a20000 0x1000>, <0x1c000000 0x1000000>;
        reg-names = "control", "memory";
        #address-cells = <1>;
        #size-cells = <0>;

        flash@1 {
            compatible = "jedec,spi-nor";
            reg = <1>;
            spi-max-frequency = <25000000>;
        };
    };
```

## Documentation/devicetree/bindings/watchdog/hisilicon,sd5116-wdt.yaml
```yaml
# SPDX-License-Identifier: (GPL-2.0-only OR BSD-2-Clause)
%YAML 1.2
---
$id: http://devicetree.org/schemas/watchdog/hisilicon,sd5116-wdt.yaml#
$schema: http://devicetree.org/meta-schemas/core.yaml#

title: HiSilicon SD5116 watchdog

maintainers:
  - Mario Moura <mm@mariomoura.com>

description:
  Watchdog timer in the HiSilicon SD5116 system controller. The boot
  firmware starts it and it cannot be stopped. It must be a child node of
  the "hisilicon,sd5116-sysctrl" system controller, whose registers it
  uses.

allOf:
  - $ref: watchdog.yaml#

properties:
  compatible:
    const: hisilicon,sd5116-wdt

required:
  - compatible

unevaluatedProperties: false

examples:
  - |
    watchdog {
        compatible = "hisilicon,sd5116-wdt";
        timeout-sec = <60>;
    };
```

## arch/arm/configs/sd5116_defconfig
```kconfig
CONFIG_KERNEL_XZ=y
CONFIG_SYSVIPC=y
CONFIG_BLK_DEV_INITRD=y
CONFIG_INITRAMFS_SOURCE="${ONU_ROOT}/initramfs/initramfs_list"
CONFIG_INITRAMFS_COMPRESSION_NONE=y
CONFIG_CC_OPTIMIZE_FOR_SIZE=y
CONFIG_EXPERT=y
CONFIG_ARCH_HISI=y
CONFIG_ARCH_SD5116=y
CONFIG_ARM_APPENDED_DTB=y
CONFIG_ARM_ATAG_DTB_COMPAT=y
CONFIG_VFP=y
# CONFIG_BLOCK is not set
CONFIG_NET=y
CONFIG_PACKET=y
CONFIG_UNIX=y
CONFIG_INET=y
CONFIG_NET_DSA=y
CONFIG_DEVTMPFS=y
CONFIG_DEVTMPFS_MOUNT=y
CONFIG_MTD=y
CONFIG_MTD_SPI_NOR=y
# CONFIG_MTD_SPI_NOR_USE_4K_SECTORS is not set
CONFIG_NETDEVICES=y
CONFIG_NET_DSA_SD5116=y
CONFIG_SD5116_PIE=y
CONFIG_MDIO_SD5116=y
CONFIG_INPUT_EVDEV=y
CONFIG_KEYBOARD_GPIO_POLLED=y
CONFIG_SERIAL_8250=y
CONFIG_SERIAL_8250_CONSOLE=y
CONFIG_SERIAL_8250_NR_UARTS=2
CONFIG_SERIAL_8250_RUNTIME_UARTS=2
CONFIG_SERIAL_8250_DW=y
CONFIG_SERIAL_OF_PLATFORM=y
CONFIG_I2C=y
CONFIG_I2C_CHARDEV=y
CONFIG_I2C_DESIGNWARE_CORE=y
CONFIG_SPI=y
CONFIG_SPI_SD5116_SFC=y
CONFIG_PINCTRL=y
CONFIG_PINCTRL_SINGLE=y
CONFIG_GPIOLIB=y
CONFIG_GPIO_DWAPB=y
CONFIG_WATCHDOG=y
CONFIG_SD5116_WATCHDOG=y
CONFIG_NEW_LEDS=y
CONFIG_LEDS_CLASS=y
CONFIG_LEDS_GPIO=y
CONFIG_LEDS_TRIGGERS=y
CONFIG_LEDS_TRIGGER_TIMER=y
CONFIG_LEDS_TRIGGER_HEARTBEAT=y
CONFIG_LEDS_TRIGGER_DEFAULT_ON=y
# CONFIG_NVMEM is not set
CONFIG_TMPFS=y
CONFIG_JFFS2_FS=y
```
